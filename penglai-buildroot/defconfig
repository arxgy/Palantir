## penglai-buildroot/package/tyrquake/Config.in
```kconfig
config BR2_PACKAGE_TYRQUAKE
	bool "TyrQuake"
	select BR2_PACKAGE_XORG7
	select BR2_PACKAGE_MESA3D
	select BR2_PACKAGE_XLIB_LIBXXF86VM
	help

	  A portable Quake.
```
